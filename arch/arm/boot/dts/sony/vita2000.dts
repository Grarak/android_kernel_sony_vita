// SPDX-License-Identifier: GPL-2.0
/*
 * Device Tree Source for the PlayStation Vita 2000 (PCH-2000, LCD)
 */

/dts-v1/;

#include "vita.dtsi"

/ {
	model = "Sony PlayStation Vita (PCH-2000)";
	compatible = "sony,pch-2000", "sony,vita", "vita,vita";

	/*
	 * 512 MiB LPDDR2 at 0x40000000 [WIKI Physical_Memory].
	 * The first 2 MiB (0x40000000-0x401FFFFF) are the secure world's.
	 */
	memory@40200000 {
		device_type = "memory";
		reg = <0x40200000 0x1fe00000>;
	};

	chosen {
		bootargs = "earlyprintk keep_bootcon console=tty0";

		/* Set up by the boot loader in CDRAM (0x20000000, 128 MiB) */
		framebuffer0: framebuffer@20000000 {
			compatible = "simple-framebuffer";
			reg = <0x20000000 (960*544*4)>;
			width = <960>;
			height = <544>;
			stride = <(960*4)>;
			format = "a8b8g8r8";
			status = "okay";
		};
	};
};
