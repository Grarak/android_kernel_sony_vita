## Documentation/devicetree/bindings/clock/sony,vita-baseclk.yaml
```yaml
# SPDX-License-Identifier: (GPL-2.0-only OR BSD-2-Clause)
%YAML 1.2
---
$id: http://devicetree.org/schemas/clock/sony,vita-baseclk.yaml#
$schema: http://devicetree.org/meta-schemas/core.yaml#

title: PlayStation Vita base clock controller (ScePervasiveBaseClk)

maintainers:
  - Willi Ye <williye97@gmail.com>

description: |
  The clock multipliers and dividers of the PlayStation Vita's CXD5315GG SoC.
  The ARM clock, which also clocks the L2 cache and, divided by two, the
  Cortex-A9 private timers, is the reference clock times a selectable
  multiplier. The clock IDs are in include/dt-bindings/clock/sony,vita-baseclk.h.

properties:
  compatible:
    const: sony,vita-baseclk

  reg:
    maxItems: 1

  clocks:
    items:
      - description: Reference clock of the ARM clock

  clock-names:
    items:
      - const: ref

  '#clock-cells':
    const: 1

required:
  - compatible
  - reg
  - clocks
  - '#clock-cells'

additionalProperties: false

examples:
  - |
    clock-controller@e3103000 {
        compatible = "sony,vita-baseclk";
        reg = <0xe3103000 0x1000>;
        clocks = <&armref>;
        clock-names = "ref";
        #clock-cells = <1>;
    };
```

## Documentation/devicetree/bindings/i2c/sony,vita-i2c.yaml
```yaml
# SPDX-License-Identifier: (GPL-2.0-only OR BSD-2-Clause)
%YAML 1.2
---
$id: http://devicetree.org/schemas/i2c/sony,vita-i2c.yaml#
$schema: http://devicetree.org/meta-schemas/core.yaml#

title: PlayStation Vita I2C controller

maintainers:
  - Willi Ye <williye97@gmail.com>

description: |
  The two I2C controllers of the PlayStation Vita's SoC (SceI2c0Reg at
  0xE0500000, SceI2c1Reg at 0xE0510000). Bus 0 carries the audio codec, the
  clock generator and the back camera's sensor; bus 1 the front camera's
  sensor and the HDMI bridge. Each transfer is a sequence of commands that
  complete with an interrupt, 64 bytes at most per data phase.

allOf:
  - $ref: /schemas/i2c/i2c-controller.yaml#

properties:
  compatible:
    const: sony,vita-i2c

  reg:
    maxItems: 1

  interrupts:
    maxItems: 1

  resets:
    maxItems: 1

  sony,speed-mode:
    $ref: /schemas/types.yaml#/definitions/uint32
    enum: [4, 5]
    default: 5
    description: |
      The value SceLowio writes to the controller's speed register (+0x18):
      5 when the Hardware Info word is below 0x800000, otherwise 4. The bus
      frequency each value selects is not established.

required:
  - compatible
  - reg
  - interrupts

unevaluatedProperties: false

examples:
  - |
    #include <dt-bindings/interrupt-controller/arm-gic.h>

    i2c@e0500000 {
        compatible = "sony,vita-i2c";
        reg = <0xe0500000 0x1000>;
        interrupts = <GIC_SPI 110 IRQ_TYPE_LEVEL_HIGH>;
        resets = <&reset 68>;
        sony,speed-mode = <5>;
        #address-cells = <1>;
        #size-cells = <0>;
    };
```

## Documentation/devicetree/bindings/nvmem/sony,vita-vid.yaml
```yaml
# SPDX-License-Identifier: (GPL-2.0-only OR BSD-2-Clause)
%YAML 1.2
---
$id: http://devicetree.org/schemas/nvmem/sony,vita-vid.yaml#
$schema: http://devicetree.org/meta-schemas/core.yaml#

title: PlayStation Vita voltage IDs (ScePervasiveVid)

maintainers:
  - Willi Ye <williye97@gmail.com>

description: |
  Read-only 32-bit words holding the chip's own voltage ID for each core rail
  and clock level. They differ from chip to chip; a rail at a level is set to
  1.38 V less the ID in 10 mV steps. The words are described as nvmem cells
  of a fixed layout.

allOf:
  - $ref: nvmem.yaml#

properties:
  compatible:
    const: sony,vita-vid

  reg:
    maxItems: 1

required:
  - compatible
  - reg

unevaluatedProperties: false

examples:
  - |
    efuse@e3104000 {
        compatible = "sony,vita-vid";
        reg = <0xe3104000 0x100>;
        read-only;

        nvmem-layout {
            compatible = "fixed-layout";
            #address-cells = <1>;
            #size-cells = <1>;

            vid@4 {
                reg = <0x04 0x4>;
            };
        };
    };
```

## Documentation/devicetree/bindings/opp/sony,vita-operating-points.yaml
```yaml
# SPDX-License-Identifier: (GPL-2.0-only OR BSD-2-Clause)
%YAML 1.2
---
$id: http://devicetree.org/schemas/opp/sony,vita-operating-points.yaml#
$schema: http://devicetree.org/meta-schemas/core.yaml#

title: PlayStation Vita CPU OPP table

maintainers:
  - Willi Ye <williye97@gmail.com>

description: |
  The voltage each ARM clock level needs differs from chip to chip. Each OPP
  names the voltage ID cell (sony,vita-vid) for its level; the CPU frequency
  driver replaces the OPP's opp-microvolt with 1.38 V less that ID in 10 mV
  steps, and disables an OPP whose ID is 0.

allOf:
  - $ref: opp-v2-base.yaml#

properties:
  compatible:
    const: sony,vita-operating-points

  opp-shared: true

required:
  - compatible

patternProperties:
  "^opp-[0-9]+$":
    type: object

    properties:
      opp-hz: true
      opp-microvolt: true
      clock-latency-ns: true

      nvmem-cells:
        maxItems: 1
        description: The voltage ID cell for this level

      nvmem-cell-names:
        const: vid

    required:
      - opp-hz
      - opp-microvolt
      - nvmem-cells
      - nvmem-cell-names

    unevaluatedProperties: false

unevaluatedProperties: false

examples:
  - |
    opp-table {
        compatible = "sony,vita-operating-points";
        opp-shared;

        opp-497088000 {
            opp-hz = /bits/ 64 <497088000>;
            opp-microvolt = <1070000>;
            clock-latency-ns = <1000000>;
            nvmem-cells = <&vid_arm_444>;
            nvmem-cell-names = "vid";
        };
    };
```

## Documentation/devicetree/bindings/regulator/sony,vita-syscon-regulator.yaml
```yaml
# SPDX-License-Identifier: (GPL-2.0-only OR BSD-2-Clause)
%YAML 1.2
---
$id: http://devicetree.org/schemas/regulator/sony,vita-syscon-regulator.yaml#
$schema: http://devicetree.org/meta-schemas/core.yaml#

title: PlayStation Vita Syscon core rails

maintainers:
  - Willi Ye <williye97@gmail.com>

description: |
  The PlayStation Vita's system controller (Syscon, "Ernie") sets the SoC's
  core rails on request, from 0.77 V to 1.38 V in 10 mV steps: VDD (buses,
  DMA), VDDA (ARM cores and L2 cache), VDDC (codec engine) and VDDG (GPU and
  GPU crossbar). The node is a child of the Syscon node; each rail it
  describes is a child node named after the rail.

  No Syscon command reads a rail back. The boot loader sets the rails to
  1.38 V less one of the chip's voltage IDs in 10 mV steps; a rail node names
  that ID's cell as "boot-vid". Without it, the rail's voltage is unknown
  until it is first set.

properties:
  compatible:
    const: sony,vita-syscon-regulator

patternProperties:
  "^vdd[acg]?$":
    $ref: regulator.yaml#
    unevaluatedProperties: false

    properties:
      nvmem-cells:
        maxItems: 1
        description: the voltage ID the boot loader set the rail from

      nvmem-cell-names:
        const: boot-vid

    dependentRequired:
      nvmem-cells: [ nvmem-cell-names ]

required:
  - compatible

additionalProperties: false

examples:
  - |
    syscon-regulator {
        compatible = "sony,vita-syscon-regulator";

        vdda {
            regulator-name = "vdda";
            regulator-min-microvolt = <800000>;
            regulator-max-microvolt = <1200000>;
            regulator-always-on;
            nvmem-cells = <&vid_arm_444>;
            nvmem-cell-names = "boot-vid";
        };
    };
```

## arch/arm/configs/vita_android_defconfig
```kconfig
CONFIG_AUDIT=y
CONFIG_BPF_SYSCALL=y
CONFIG_BPF_JIT=y
CONFIG_PSI=y
CONFIG_IKCONFIG=y
CONFIG_IKCONFIG_PROC=y
CONFIG_CGROUPS=y
CONFIG_MEMCG=y
CONFIG_MEMCG_V1=y
CONFIG_BLK_CGROUP=y
CONFIG_CGROUP_SCHED=y
CONFIG_RT_GROUP_SCHED=y
CONFIG_CGROUP_FREEZER=y
CONFIG_CPUSETS=y
CONFIG_CPUSETS_V1=y
CONFIG_CGROUP_CPUACCT=y
CONFIG_CGROUP_BPF=y
CONFIG_NAMESPACES=y
CONFIG_BLK_DEV_INITRD=y
# CONFIG_RD_BZIP2 is not set
# CONFIG_RD_LZMA is not set
# CONFIG_RD_LZO is not set
CONFIG_SYSFS_SYSCALL=y
CONFIG_EXPERT=y
CONFIG_KALLSYMS_ALL=y
CONFIG_PROFILING=y
# CONFIG_ARM_PATCH_PHYS_VIRT is not set
CONFIG_PHYS_OFFSET=0x41000000
# CONFIG_ARCH_MULTIPLATFORM is not set
CONFIG_ARCH_VITA=y
CONFIG_PL310_ERRATA_769419=y
# CONFIG_ARM_ERRATA_643719 is not set
CONFIG_ARM_ERRATA_754322=y
CONFIG_ARM_ERRATA_764369=y
CONFIG_ARM_ERRATA_775420=y
CONFIG_SMP=y
# CONFIG_SMP_ON_UP is not set
CONFIG_HAVE_ARM_ARCH_TIMER=y
CONFIG_HOTPLUG_CPU=y
CONFIG_HZ_250=y
CONFIG_THUMB2_KERNEL=y
CONFIG_HIGHMEM=y
CONFIG_ATAGS=y
CONFIG_ZBOOT_ROM_TEXT=0
CONFIG_ZBOOT_ROM_BSS=0
# CONFIG_AUTO_ZRELADDR is not set
CONFIG_CPU_IDLE=y
CONFIG_VFP=y
CONFIG_NEON=y
CONFIG_KERNEL_MODE_NEON=y
# CONFIG_SUSPEND is not set
CONFIG_PM=y
# CONFIG_SCHED_SMT is not set
# CONFIG_SCHED_MC is not set
CONFIG_PARTITION_ADVANCED=y
# CONFIG_IOSCHED_BFQ is not set
CONFIG_KSM=y
CONFIG_CMA=y
CONFIG_CMA_AREAS=7
CONFIG_NET=y
CONFIG_PACKET=y
CONFIG_UNIX=y
CONFIG_XFRM_USER=y
CONFIG_NET_KEY=y
CONFIG_INET=y
CONFIG_IP_ADVANCED_ROUTER=y
CONFIG_IP_MULTIPLE_TABLES=y
CONFIG_INET_ESP=y
CONFIG_IPV6_ROUTER_PREF=y
CONFIG_IPV6_ROUTE_INFO=y
CONFIG_IPV6_OPTIMISTIC_DAD=y
CONFIG_INET6_ESP=y
CONFIG_IPV6_MULTIPLE_TABLES=y
CONFIG_NETFILTER=y
CONFIG_NF_CONNTRACK=y
CONFIG_NF_CONNTRACK_SECMARK=y
CONFIG_NF_CONNTRACK_EVENTS=y
CONFIG_NF_CONNTRACK_FTP=y
CONFIG_NF_CONNTRACK_TFTP=y
CONFIG_NF_CT_NETLINK=y
CONFIG_NETFILTER_XTABLES_LEGACY=y
CONFIG_NETFILTER_XT_TARGET_CLASSIFY=y
CONFIG_NETFILTER_XT_TARGET_CONNMARK=y
CONFIG_NETFILTER_XT_TARGET_CONNSECMARK=y
CONFIG_NETFILTER_XT_TARGET_IDLETIMER=y
CONFIG_NETFILTER_XT_TARGET_MARK=y
CONFIG_NETFILTER_XT_TARGET_NFLOG=y
CONFIG_NETFILTER_XT_TARGET_NFQUEUE=y
CONFIG_NETFILTER_XT_TARGET_TPROXY=y
CONFIG_NETFILTER_XT_TARGET_TRACE=y
CONFIG_NETFILTER_XT_TARGET_SECMARK=y
CONFIG_NETFILTER_XT_TARGET_TCPMSS=y
CONFIG_NETFILTER_XT_MATCH_BPF=y
CONFIG_NETFILTER_XT_MATCH_COMMENT=y
CONFIG_NETFILTER_XT_MATCH_CONNLIMIT=y
CONFIG_NETFILTER_XT_MATCH_CONNMARK=y
CONFIG_NETFILTER_XT_MATCH_CONNTRACK=y
CONFIG_NETFILTER_XT_MATCH_HASHLIMIT=y
CONFIG_NETFILTER_XT_MATCH_HELPER=y
CONFIG_NETFILTER_XT_MATCH_IPRANGE=y
CONFIG_NETFILTER_XT_MATCH_LENGTH=y
CONFIG_NETFILTER_XT_MATCH_LIMIT=y
CONFIG_NETFILTER_XT_MATCH_MAC=y
CONFIG_NETFILTER_XT_MATCH_MARK=y
CONFIG_NETFILTER_XT_MATCH_OWNER=y
CONFIG_NETFILTER_XT_MATCH_POLICY=y
CONFIG_NETFILTER_XT_MATCH_PKTTYPE=y
CONFIG_NETFILTER_XT_MATCH_QUOTA=y
CONFIG_NETFILTER_XT_MATCH_SOCKET=y
CONFIG_NETFILTER_XT_MATCH_STATE=y
CONFIG_NETFILTER_XT_MATCH_STATISTIC=y
CONFIG_NETFILTER_XT_MATCH_STRING=y
CONFIG_NETFILTER_XT_MATCH_TIME=y
CONFIG_NETFILTER_XT_MATCH_U32=y
CONFIG_IP_NF_IPTABLES=y
CONFIG_IP_NF_TARGET_REJECT=y
CONFIG_IP_NF_NAT=y
CONFIG_IP_NF_TARGET_MASQUERADE=y
CONFIG_IP_NF_TARGET_NETMAP=y
CONFIG_IP_NF_TARGET_REDIRECT=y
CONFIG_IP_NF_RAW=y
CONFIG_IP_NF_SECURITY=y
CONFIG_IP_NF_ARPFILTER=y
CONFIG_IP_NF_ARP_MANGLE=y
CONFIG_IP6_NF_IPTABLES=y
CONFIG_IP6_NF_TARGET_REJECT=y
CONFIG_IP6_NF_RAW=y
CONFIG_L2TP=y
CONFIG_NET_SCHED=y
CONFIG_NET_SCH_HTB=y
CONFIG_NET_SCH_INGRESS=y
CONFIG_NET_CLS_U32=y
CONFIG_NET_CLS_BPF=y
CONFIG_NET_EMATCH=y
CONFIG_NET_EMATCH_U32=y
CONFIG_NET_CLS_ACT=y
CONFIG_BT=y
CONFIG_BT_MRVL=y
CONFIG_BT_MRVL_SDIO=y
CONFIG_CFG80211=y
CONFIG_RFKILL=y
CONFIG_DEVTMPFS=y
CONFIG_FW_LOADER_USER_HELPER=y
CONFIG_FW_LOADER_USER_HELPER_FALLBACK=y
CONFIG_BLK_DEV_NULL_BLK=y
CONFIG_ZRAM=y
CONFIG_ZRAM_BACKEND_LZ4=y
CONFIG_BLK_DEV_LOOP=y
CONFIG_BLK_DEV_LOOP_MIN_COUNT=16
CONFIG_BLK_DEV_VITA_MSIF=y
CONFIG_MD=y
CONFIG_BLK_DEV_DM=y
CONFIG_DM_CRYPT=y
CONFIG_NETDEVICES=y
CONFIG_TUN=y
CONFIG_PPP=y
CONFIG_PPP_BSDCOMP=y
CONFIG_PPP_DEFLATE=y
CONFIG_PPP_MPPE=y
CONFIG_MWIFIEX=y
CONFIG_MWIFIEX_SDIO=y
CONFIG_INPUT_FF_MEMLESS=y
CONFIG_INPUT_MOUSEDEV=y
CONFIG_INPUT_JOYDEV=y
CONFIG_INPUT_EVDEV=y
# CONFIG_KEYBOARD_ATKBD is not set
# CONFIG_MOUSE_PS2 is not set
CONFIG_INPUT_JOYSTICK=y
CONFIG_JOYSTICK_VITA_BUTTONS=y
CONFIG_INPUT_TOUCHSCREEN=y
CONFIG_TOUCHSCREEN_VITA_SYSCON=y
CONFIG_INPUT_MISC=y
CONFIG_INPUT_UINPUT=y
CONFIG_SERIO_LIBPS2=y
CONFIG_SERIAL_VITA_UART=y
CONFIG_SERIAL_VITA_UART_CONSOLE=y
CONFIG_SPI=y
CONFIG_SPI_VITA=y
# CONFIG_PTP_1588_CLOCK is not set
CONFIG_GPIOLIB=y
CONFIG_GPIO_SYSFS=y
CONFIG_GPIO_CDEV_V1=y
CONFIG_GPIO_VITA=y
# CONFIG_HWMON is not set
CONFIG_DRM=y
CONFIG_DRM_PSP2SGX=y
CONFIG_FB=y
CONFIG_FB_SIMPLE=y
CONFIG_FRAMEBUFFER_CONSOLE=y
CONFIG_FRAMEBUFFER_CONSOLE_DETECT_PRIMARY=y
CONFIG_HIDRAW=y
CONFIG_UHID=y
CONFIG_USB_GADGET=y
CONFIG_USB_VITA_UDC=y
CONFIG_USB_CONFIGFS=y
CONFIG_USB_CONFIGFS_F_FS=y
CONFIG_MMC=y
CONFIG_PWRSEQ_VITA_WLANBT=y
CONFIG_MMC_BLOCK_MINORS=16
CONFIG_MMC_SDHCI=y
CONFIG_MMC_SDHCI_PLTFM=y
CONFIG_MMC_SDHCI_VITA=y
CONFIG_NEW_LEDS=y
CONFIG_LEDS_CLASS=y
CONFIG_LEDS_GPIO=y
CONFIG_LEDS_TRIGGERS=y
CONFIG_LEDS_TRIGGER_TIMER=y
CONFIG_LEDS_TRIGGER_HEARTBEAT=y
CONFIG_LEDS_TRIGGER_CPU=y
CONFIG_LEDS_TRIGGER_ACTIVITY=y
CONFIG_RTC_CLASS=y
CONFIG_RTC_DRV_VITA=y
CONFIG_SYNC_FILE=y
CONFIG_SW_SYNC=y
CONFIG_DMABUF_HEAPS=y
CONFIG_DMABUF_HEAPS_SYSTEM=y
# CONFIG_VIRTIO_MENU is not set
CONFIG_STAGING=y
# CONFIG_IOMMU_SUPPORT is not set
CONFIG_ASHMEM=y
CONFIG_ANDROID_BINDER_IPC=y
# CONFIG_ANDROID_BINDERFS is not set
CONFIG_EXT4_FS=y
CONFIG_EXT4_FS_POSIX_ACL=y
CONFIG_EXT4_FS_SECURITY=y
CONFIG_F2FS_FS=y
CONFIG_F2FS_FS_SECURITY=y
CONFIG_QUOTA=y
CONFIG_QFMT_V2=y
CONFIG_FUSE_FS=y
CONFIG_VFAT_FS=y
CONFIG_FAT_DEFAULT_UTF8=y
CONFIG_EXFAT_FS=y
CONFIG_TMPFS=y
CONFIG_TMPFS_POSIX_ACL=y
CONFIG_NLS_CODEPAGE_437=y
CONFIG_NLS_ISO8859_1=y
CONFIG_NLS_UTF8=y
CONFIG_SECURITY=y
CONFIG_SECURITYFS=y
CONFIG_SECURITY_NETWORK=y
CONFIG_SECURITY_SELINUX=y
CONFIG_SECURITY_SELINUX_BOOTPARAM=y
CONFIG_LSM="selinux"
CONFIG_INIT_STACK_NONE=y
CONFIG_CRYPTO_LZO=y
CONFIG_CRYPTO_LZ4=y
CONFIG_CRYPTO_AES_ARM_BS=y
CONFIG_DMA_CMA=y
CONFIG_PRINTK_TIME=y
CONFIG_FRAME_WARN=1024
# CONFIG_WARN_CONTEXT_ANALYSIS is not set
CONFIG_MAGIC_SYSRQ=y
CONFIG_DEBUG_FS=y
# CONFIG_FTRACE is not set
CONFIG_DEBUG_LL=y
CONFIG_DEBUG_UNCOMPRESS=y
CONFIG_EARLY_PRINTK=y
```

## arch/arm/mach-vita/Kconfig
```kconfig
# SPDX-License-Identifier: GPL-2.0-only
config ARCH_VITA
	bool "Sony PlayStation Vita (CXD5315GG)"
	depends on ARCH_MULTI_V7
	select ARM_GIC
	select ARM_GLOBAL_TIMER
	select CACHE_L2X0
	select HAVE_ARM_SCU if SMP
	select HAVE_ARM_TWD if SMP
	select ARCH_HAS_RESET_CONTROLLER
	select RESET_CONTROLLER
	select PM_GENERIC_DOMAINS if PM
	help
	  Support for the Sony PlayStation Vita family (PCH-1000, PCH-2000,
	  VTE-1000 PlayStation TV and the DevKit/TestKit units), built around
	  the CXD5315GG SoC: 4x Cortex-A9 MPCore r2p10, PL310 L2 cache r3p1,
	  PowerVR SGX543MP4+.
```

## drivers/gpu/drm/psp2sgx/Kconfig
```kconfig
# SPDX-License-Identifier: GPL-2.0-only

config DRM_PSP2SGX
	tristate "PlayStation Vita SGX543MP4+ GPU"
	depends on DRM
	depends on ARM || COMPILE_TEST
	depends on MMU
	depends on OF
	select DRM_SCHED
	select DRM_GEM_SHMEM_HELPER
	select DRM_EXEC
	select SYNC_FILE
	help
	  DRM render driver for the PowerVR SGX543MP4+ of the Sony
	  PlayStation Vita. The driver assembles and runs its own GPU
	  microkernel; Mesa's psp2sgx gallium driver is its userspace.
```

## drivers/gpu/drm/vita/Kconfig
```kconfig
# SPDX-License-Identifier: GPL-2.0-only
config DRM_VITA
	tristate "PlayStation Vita display (OLED head)"
	depends on DRM && OF
	depends on ARM || COMPILE_TEST
	select BACKLIGHT_CLASS_DEVICE
	select DRM_CLIENT_SELECTION
	select DRM_KMS_HELPER
	select DRM_GEM_DMA_HELPER
	help
	  KMS driver for the display of the Sony PlayStation Vita PCH-1000
	  and DevKit: the DSI0 link, the IFTU0 compositor, the display
	  clocks and the OLED panel on SPI2, brought up the way the Vita OS
	  does. Scanout buffers come from a CDRAM memory-region.
```
